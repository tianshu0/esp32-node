## main/Kconfig.projbuild
```kconfig
menu "Node project"

    choice BOARD_TYPE
        prompt "Board type"
        default BOARD_ESP32S3_TFT_FAN
        help
            选择目标项目。项目决定芯片、显示屏、传感器与外设的全套组合，
            对应 main/boards/<name>/ 目录。
            也可在 ESP-IDF shell 中执行 python scripts/release.py <项目> 一键构建。

        config BOARD_ESP32C3_SHT3X
            bool "ESP32C3 OLED 温湿度气压节点 (SSD1315 + SHT3X + BMP180)"
            select NODE_SENSOR_SHT3X
            select NODE_DISPLAY_SSD1315

        config BOARD_ESP32C3_VOC21
            bool "ESP32C3 OLED 甲醛空气质量节点 (SSD1315 + 21VOC)"
            select NODE_SENSOR_VOC21
            select NODE_DISPLAY_SSD1315

        config BOARD_ESP32S3_TFT_FAN
            bool "ESP32S3 TFT 风扇控制节点 (ILI9341 + XPT2046 + AHT30)"
            select NODE_SENSOR_AHT30
            select NODE_DISPLAY_ILI9341_240X320
            select NODE_TOUCH_XPT2046
    endchoice

    # ----------------------------------------------------------------------
    # 内部开关：无 prompt，不在 menuconfig 显示，完全由所选项目的 select 锁定。
    # 各组件 CMakeLists.txt 按这些符号条件编入源文件，源码中也可 #if 使用。
    # 新增项目时只需在上方 choice 里 select 它们，不要给它们加 prompt。
    # ----------------------------------------------------------------------

    config NODE_SENSOR_SHT3X
        bool

    config NODE_SENSOR_AHT30
        bool

    config NODE_SENSOR_BMP180
        bool

    config NODE_SENSOR_BMP280
        bool

    config NODE_SENSOR_VOC21
        bool

    config NODE_DISPLAY_SSD1315
        bool

    config NODE_DISPLAY_SSD1306_128X32
        bool

    config NODE_DISPLAY_ILI9341_240X320
        bool

    config NODE_TOUCH_XPT2046
        bool

endmenu
```
